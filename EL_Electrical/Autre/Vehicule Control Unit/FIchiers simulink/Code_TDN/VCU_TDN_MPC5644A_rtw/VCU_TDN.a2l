/******************************************************************************
* ASAP2 file: VCU_TDN.a2l
* Academic License - for use in teaching, academic research, and meeting
* course requirements at degree granting institutions only. Not for
* government, commercial, or other organizational use.
* Code generation for model "VCU_TDN".
* Model version : 1.21
* Simulink Coder version : 9.3 (R2020a) 18-Nov-2019
* C source code generated on : Tue Mar 1 18:01:29 2022
* Target selection: MPC5644A.tlc
* Embedded hardware selection: Freescale->MPC55xx
* Code generation objectives: Unspecified
* Validation result: Not run
* (add additional file header information here)
******************************************************************************/ ASAP2_VERSION 1 31
/* Version 1.31 */
/begin PROJECT ProjectName "Project Comment Goes Here"
/begin HEADER "Header Comments go here" /end HEADER
/begin MODULE ModuleName "Module Comment Goes Here"
/* EcoCoder V2.9.5 R2 Target:EV2274A verCalTool:0.0*/
/* XCP-En:0 XCPCalTool:EcoCAL INCA CANape XCP-CAN:CAN_CTRL_C XCP-CAN-Baud:500kbps*/
/* CCP-En:1 CCP-TYPE:Configurable CCPCalTool:EcoCAL INCA CCP-CAN:CAN_CTRL_B CCP-CAN-Baud:500kbps*/
/*PGCANAEn:NoUse PGCANAStation:NoUse PGCANABaud:500kbps PGCANACRO:NoUse PGCANADTO:NoUse*/
/*PGCANBEn:NoUse PGCANBStation:NoUse PGCANBBaud:500kbps PGCANBCRO:NoUse PGCANBDTO:NoUse*/
/*PGCANCEn:NoUse PGCANCStation:NoUse PGCANCBaud:500kbps PGCANCCRO:NoUse PGCANCDTO:NoUse*/
/*PGCANDEn:NoUse PGCANDStation:NoUse PGCANDBaud:NoUsekbps PGCANDCRO:NoUse PGCANDDTO:NoUse*/
/*ECO_XCP_Note_Start
/begin IF_DATA XCP
/begin PROTOCOL_LAYER
0x0100
0x07D0
0x2710
0x3E8
0x2710
0x3E8
0x19
0x19
0x08
0x08
BYTE_ORDER_MSB_FIRST
ADDRESS_GRANULARITY_BYTE
OPTIONAL_CMD ALLOC_ODT_ENTRY
OPTIONAL_CMD ALLOC_ODT
OPTIONAL_CMD ALLOC_DAQ
OPTIONAL_CMD FREE_DAQ
OPTIONAL_CMD GET_DAQ_EVENT_INFO
OPTIONAL_CMD GET_DAQ_RESOLUTION_INFO
OPTIONAL_CMD GET_DAQ_PROCESSOR_INFO
OPTIONAL_CMD START_STOP_SYNCH
OPTIONAL_CMD START_STOP_DAQ_LIST
OPTIONAL_CMD GET_DAQ_LIST_MODE
OPTIONAL_CMD SET_DAQ_LIST_MODE
OPTIONAL_CMD WRITE_DAQ
OPTIONAL_CMD SET_DAQ_PTR
OPTIONAL_CMD CLEAR_DAQ_LIST
OPTIONAL_CMD DOWNLOAD
OPTIONAL_CMD SHORT_UPLOAD
OPTIONAL_CMD UPLOAD
OPTIONAL_CMD SET_MTA
OPTIONAL_CMD UNLOCK
OPTIONAL_CMD GET_SEED
OPTIONAL_CMD GET_ID
OPTIONAL_CMD GET_COMM_MODE_INFO
OPTIONAL_CMD BUILD_CHECKSUM
SEED_AND_KEY_EXTERNAL_FUNCTION ""
/end PROTOCOL_LAYER
/begin DAQ
DYNAMIC
0x00
0x05
0x00
OPTIMISATION_TYPE_DEFAULT
ADDRESS_EXTENSION_FREE
IDENTIFICATION_FIELD_TYPE_ABSOLUTE
GRANULARITY_ODT_ENTRY_SIZE_DAQ_BYTE
0x07
OVERLOAD_INDICATION_PID
/begin STIM
GRANULARITY_ODT_ENTRY_SIZE_STIM_BYTE
0x07
/end STIM
/begin EVENT
"5ms"
"5ms"
0x00
DAQ
0x01
0x05
0x06
0x00
/end EVENT
/begin EVENT
"20ms"
"20ms"
0x01
DAQ
0x01
0x02
0x07
0x00
/end EVENT
/begin EVENT
"50ms"
"50ms"
0x02
DAQ
0x01
0x05
0x07
0x00
/end EVENT
/begin EVENT
"100ms"
"100ms"
0x03
DAQ
0x01
0x01
0x08
0x00
/end EVENT
/begin EVENT
"200ms"
"200m"
0x04
DAQ
0x01
0x02
0x08
0x00
/end EVENT
/end DAQ
/begin PAG
0x00
/end PAG
/begin PGM
PGM_MODE_ABSOLUTE
0x00
0x00
/end PGM
/begin XCP_ON_CAN
0x0100
CAN_ID_MASTER 0x100
CAN_ID_SLAVE 0x101
BAUDRATE 500000
SAMPLE_POINT 0x4B
SAMPLE_RATE SINGLE
BTL_CYCLES 0x08
SJW 0x02
SYNC_EDGE SINGLE
/end XCP_ON_CAN
/end IF_DATA
/begin IF_DATA CANAPE_ADDRESS_UPDATE
/end IF_DATA
/begin MOD_PAR "_default_ModParComment"
/begin MEMORY_SEGMENT _ROMCAL
"calibration_rom"
DATA
FLASH
INTERN
0x00FD0000
0x8000
-1 -1 -1 -1 -1
/begin IF_DATA XCP
/begin SEGMENT
0x00
0x01
0x00
0x00
0x00
/begin CHECKSUM
XCP_CRC_16_CITT
MAX_BLOCK_SIZE 0xFFFF
EXTERNAL_FUNCTION "String.Empty"
/end CHECKSUM
/begin PAGE
0x00
ECU_ACCESS_DONT_CARE
XCP_READ_ACCESS_DONT_CARE
XCP_WRITE_ACCESS_DONT_CARE
INIT_SEGMENT 0x00
/end PAGE
/begin ADDRESS_MAPPING
0x00FD0000
0x40000000
0x8000
/end ADDRESS_MAPPING
/end SEGMENT
/end IF_DATA
/end MEMORY_SEGMENT
/begin MEMORY_SEGMENT _CODE
"ecu_code"
CODE
FLASH
INTERN
0x01000200
0x1FFA00
-1 -1 -1 -1 -1
/end MEMORY_SEGMENT
/end MOD_PAR
ECO_XCP_Note_End*/
/*ECO_CCP_Note_Start*/
/begin MOD_PAR "_default_ModParComment" ADDR_EPK 0x01000100 EPK "2022-03-01 18:01:38"
 /begin MEMORY_SEGMENT _RAMCAL "calibration_ram" DATA RAM INTERN 0x40000000 0x8000 -1 -1 -1 -1 -1 /end MEMORY_SEGMENT
 /begin MEMORY_SEGMENT _ROMCAL "calibration_rom" DATA FLASH INTERN 0x00FD0000 0x8000 -1 -1 -1 -1 -1
  /begin IF_DATA ASAP1B_CCP ADDRESS_MAPPING 0x00FD0000 0x40000000 0x8000 /*EcoCoderCANapeStart
ADDR_MAPPING 0x00FD0000 0x40000000 0x8000
EcoCoderCANapeEnd*/ /end IF_DATA
 /end MEMORY_SEGMENT
 /begin MEMORY_SEGMENT _epk_data "epk_data" DATA FLASH INTERN 0x01000100 0xFF -1 -1 -1 -1 -1
  /begin IF_DATA ASAP1B_CCP ADDRESS_MAPPING 0x01000100 0x01000100 0xFF /*EcoCoderCANapeStart
ADDR_MAPPING 0x01000100 0x01000100 0xFF
EcoCoderCANapeEnd*/ /end IF_DATA
 /end MEMORY_SEGMENT
 /begin MEMORY_SEGMENT _CODE "ecu_code" CODE FLASH INTERN 0x01000200 0x1FFA00 -1 -1 -1 -1 -1 /end MEMORY_SEGMENT
/end MOD_PAR
/begin IF_DATA ASAP1B_CCP
 /begin SOURCE "20ms" 3 20 DISPLAY_IDENTIFIER DAQ2
  /begin QP_BLOB 1 LENGTH 0x20 CAN_ID_FIXED 0x101 RASTER 1 REDUCTION_ALLOWED FIRST_PID 0x3C /end QP_BLOB
 /end SOURCE
 /begin SOURCE "100ms" 3 100 DISPLAY_IDENTIFIER DAQ3
  /begin QP_BLOB 2 LENGTH 0x30 CAN_ID_FIXED 0x101 RASTER 2 REDUCTION_ALLOWED FIRST_PID 0x78 /end QP_BLOB
 /end SOURCE
 /begin RASTER "20ms" "20ms" 1 3 20 /end RASTER
 /begin RASTER "100ms" "100ms" 2 3 100 /end RASTER
 /begin SEED_KEY "" "" "" /end SEED_KEY
 /begin CHECKSUM "CRC16.dll" /end CHECKSUM
 /begin TP_BLOB 0x0201 0x0204 0x100 0x101 0x112 1 BAUDRATE 500000 SAMPLE_POINT 70 SAMPLE_RATE 1 BTL_CYCLES 10 SJW 1 SYNC_EDGE SINGLE DAQ_MODE 0 CONSISTENCY 1 ADDRESS_EXTENSION 0 RESUME_SUPPORTED STORE_SUPPORTED
  /begin CHECKSUM_PARAM 0x9001 /*EcoCoderCANapeStart
0x0C
EcoCoderCANapeEnd*/ 0xffffffff CHECKSUM_CALCULATION ACTIVE_PAGE /end CHECKSUM_PARAM
  /begin DEFINED_PAGES 0x00 "RAM_PAGE" 0x00 0x40000000 0x8000 RAM RAM_INIT_BY_ECU /end DEFINED_PAGES
  OPTIONAL_CMD 0X5 OPTIONAL_CMD 0X8 OPTIONAL_CMD 0X9 OPTIONAL_CMD 0XC OPTIONAL_CMD 0XD OPTIONAL_CMD 0XE OPTIONAL_CMD 0XF OPTIONAL_CMD 0X10 OPTIONAL_CMD 0X11 OPTIONAL_CMD 0X12 OPTIONAL_CMD 0X13 OPTIONAL_CMD 0X18 OPTIONAL_CMD 0X19 OPTIONAL_CMD 0X20 OPTIONAL_CMD 0X21 OPTIONAL_CMD 0X22 OPTIONAL_CMD 0X23 /end TP_BLOB
/end IF_DATA
/*ECO_CCP_Note_End*/
/begin MOD_COMMON "" /* Comment */ ALIGNMENT_BYTE 1 ALIGNMENT_WORD 1 ALIGNMENT_LONG 1 ALIGNMENT_FLOAT32_IEEE 1 ALIGNMENT_FLOAT64_IEEE 1 BYTE_ORDER MSB_FIRST DEPOSIT ABSOLUTE /end MOD_COMMON
/begin RECORD_LAYOUT Scalar_BOOLEAN FNC_VALUES 1 UBYTE COLUMN_DIR DIRECT /end RECORD_LAYOUT
/begin RECORD_LAYOUT Scalar_UBYTE FNC_VALUES 1 UBYTE COLUMN_DIR DIRECT /end RECORD_LAYOUT
/begin RECORD_LAYOUT Scalar_BYTE FNC_VALUES 1 SBYTE COLUMN_DIR DIRECT /end RECORD_LAYOUT
/begin RECORD_LAYOUT Scalar_UWORD FNC_VALUES 1 UWORD COLUMN_DIR DIRECT /end RECORD_LAYOUT
/begin RECORD_LAYOUT Scalar_SWORD FNC_VALUES 1 SWORD COLUMN_DIR DIRECT /end RECORD_LAYOUT
/begin RECORD_LAYOUT Scalar_ULONG FNC_VALUES 1 ULONG COLUMN_DIR DIRECT /end RECORD_LAYOUT
/begin RECORD_LAYOUT Scalar_LONG FNC_VALUES 1 SLONG COLUMN_DIR DIRECT /end RECORD_LAYOUT
/begin RECORD_LAYOUT Scalar_FLOAT32_IEEE FNC_VALUES 1 FLOAT32_IEEE COLUMN_DIR DIRECT /end RECORD_LAYOUT
/begin RECORD_LAYOUT Scalar_FLOAT64_IEEE FNC_VALUES 1 FLOAT64_IEEE COLUMN_DIR DIRECT /end RECORD_LAYOUT
/begin RECORD_LAYOUT Lookup1D_BOOLEAN FNC_VALUES 1 UBYTE COLUMN_DIR DIRECT /end RECORD_LAYOUT
/begin RECORD_LAYOUT Lookup1D_X_BOOLEAN AXIS_PTS_X 1 UBYTE INDEX_INCR DIRECT /end RECORD_LAYOUT
/begin RECORD_LAYOUT Lookup1D_BYTE FNC_VALUES 1 SBYTE COLUMN_DIR DIRECT /end RECORD_LAYOUT
/begin RECORD_LAYOUT Lookup1D_X_BYTE AXIS_PTS_X 1 SBYTE INDEX_INCR DIRECT /end RECORD_LAYOUT
/begin RECORD_LAYOUT Lookup1D_UBYTE FNC_VALUES 1 UBYTE COLUMN_DIR DIRECT /end RECORD_LAYOUT
/begin RECORD_LAYOUT Lookup1D_X_UBYTE AXIS_PTS_X 1 UBYTE INDEX_INCR DIRECT /end RECORD_LAYOUT
/begin RECORD_LAYOUT Lookup1D_UWORD FNC_VALUES 1 UWORD COLUMN_DIR DIRECT /end RECORD_LAYOUT
/begin RECORD_LAYOUT Lookup1D_X_UWORD AXIS_PTS_X 1 UWORD INDEX_INCR DIRECT /end RECORD_LAYOUT
/begin RECORD_LAYOUT Lookup1D_WORD FNC_VALUES 1 SWORD COLUMN_DIR DIRECT /end RECORD_LAYOUT
/begin RECORD_LAYOUT Lookup1D_X_WORD AXIS_PTS_X 1 SWORD INDEX_INCR DIRECT /end RECORD_LAYOUT
/begin RECORD_LAYOUT Lookup1D_ULONG FNC_VALUES 1 ULONG COLUMN_DIR DIRECT /end RECORD_LAYOUT
/begin RECORD_LAYOUT Lookup1D_X_ULONG AXIS_PTS_X 1 ULONG INDEX_INCR DIRECT /end RECORD_LAYOUT
/begin RECORD_LAYOUT Lookup1D_SLONG FNC_VALUES 1 SLONG COLUMN_DIR DIRECT /end RECORD_LAYOUT
/begin RECORD_LAYOUT Lookup1D_X_LONG AXIS_PTS_X 1 SLONG INDEX_INCR DIRECT /end RECORD_LAYOUT
/begin RECORD_LAYOUT Lookup1D_FLOAT32_IEEE FNC_VALUES 1 FLOAT32_IEEE COLUMN_DIR DIRECT /end RECORD_LAYOUT
/begin RECORD_LAYOUT Lookup1D_X_FLOAT32_IEEE AXIS_PTS_X 1 FLOAT32_IEEE INDEX_INCR DIRECT /end RECORD_LAYOUT
/begin RECORD_LAYOUT Lookup1D_FLOAT64_IEEE FNC_VALUES 1 FLOAT64_IEEE COLUMN_DIR DIRECT /end RECORD_LAYOUT
/begin RECORD_LAYOUT Lookup1D_X_FLOAT64_IEEE AXIS_PTS_X 1 FLOAT64_IEEE INDEX_INCR DIRECT /end RECORD_LAYOUT
/begin RECORD_LAYOUT Lookup2D_BOOLEAN FNC_VALUES 1 UBYTE COLUMN_DIR DIRECT /end RECORD_LAYOUT
/begin RECORD_LAYOUT Lookup2D_X_BOOLEAN AXIS_PTS_X 1 UBYTE INDEX_INCR DIRECT /end RECORD_LAYOUT
/begin RECORD_LAYOUT Lookup2D_UBYTE FNC_VALUES 1 UBYTE COLUMN_DIR DIRECT /end RECORD_LAYOUT
/begin RECORD_LAYOUT Lookup2D_X_UBYTE AXIS_PTS_X 1 UBYTE INDEX_INCR DIRECT /end RECORD_LAYOUT
/begin RECORD_LAYOUT Lookup2D_BYTE FNC_VALUES 1 SBYTE COLUMN_DIR DIRECT /end RECORD_LAYOUT
/begin RECORD_LAYOUT Lookup2D_X_BYTE AXIS_PTS_X 1 SBYTE INDEX_INCR DIRECT /end RECORD_LAYOUT
/begin RECORD_LAYOUT Lookup2D_UWORD FNC_VALUES 1 UWORD COLUMN_DIR DIRECT /end RECORD_LAYOUT
/begin RECORD_LAYOUT Lookup2D_X_UWORD AXIS_PTS_X 1 UWORD INDEX_INCR DIRECT /end RECORD_LAYOUT
/begin RECORD_LAYOUT Lookup2D_WORD FNC_VALUES 1 SWORD COLUMN_DIR DIRECT /end RECORD_LAYOUT
/begin RECORD_LAYOUT Lookup2D_X_WORD AXIS_PTS_X 1 SWORD INDEX_INCR DIRECT /end RECORD_LAYOUT
/begin RECORD_LAYOUT Lookup2D_ULONG FNC_VALUES 1 ULONG COLUMN_DIR DIRECT /end RECORD_LAYOUT
/begin RECORD_LAYOUT Lookup2D_X_ULONG AXIS_PTS_X 1 ULONG INDEX_INCR DIRECT /end RECORD_LAYOUT
/begin RECORD_LAYOUT Lookup2D_LONG FNC_VALUES 1 SLONG COLUMN_DIR DIRECT /end RECORD_LAYOUT
/begin RECORD_LAYOUT Lookup2D_X_LONG AXIS_PTS_X 1 SLONG INDEX_INCR DIRECT /end RECORD_LAYOUT
/begin RECORD_LAYOUT Lookup2D_FLOAT32_IEEE FNC_VALUES 1 FLOAT32_IEEE COLUMN_DIR DIRECT /end RECORD_LAYOUT
/begin RECORD_LAYOUT Lookup2D_X_FLOAT32_IEEE AXIS_PTS_X 1 FLOAT32_IEEE INDEX_INCR DIRECT /end RECORD_LAYOUT
/begin RECORD_LAYOUT Lookup2D_FLOAT64_IEEE FNC_VALUES 1 FLOAT64_IEEE COLUMN_DIR DIRECT /end RECORD_LAYOUT
/begin RECORD_LAYOUT Lookup2D_X_FLOAT64_IEEE AXIS_PTS_X 1 FLOAT64_IEEE INDEX_INCR DIRECT /end RECORD_LAYOUT
/begin CHARACTERISTIC Vdc_bus_V_cur "" CURVE 0x0000 /* @ECU_Address@Vdc_bus_V_cur@ */ Lookup1D_WORD 0 VCU_TDN_CM_int16 -32768 32767
 /begin AXIS_DESCR COM_AXIS NO_INPUT_QUANTITY VCU_TDN_CM_int16 42 -32768 32767 AXIS_PTS_REF Vdc_bus_V_bp /end AXIS_DESCR
/end CHARACTERISTIC
/begin CHARACTERISTIC T_IGBT_conversion_cur "" CURVE 0x0000 /* @ECU_Address@T_IGBT_conversion_cur@ */ Lookup1D_WORD 0 VCU_TDN_CM_int16 -32768 32767
 /begin AXIS_DESCR COM_AXIS NO_INPUT_QUANTITY VCU_TDN_CM_int16 39 -32768 32767 AXIS_PTS_REF T_IGBT_conversion_bp /end AXIS_DESCR
/end CHARACTERISTIC
/begin CHARACTERISTIC T_motor_conversion_cur "" CURVE 0x0000 /* @ECU_Address@T_motor_conversion_cur@ */ Lookup1D_WORD 0 VCU_TDN_CM_int16 -32768 32767
 /begin AXIS_DESCR COM_AXIS NO_INPUT_QUANTITY VCU_TDN_CM_int16 39 -32768 32767 AXIS_PTS_REF T_motor_conversion_bp /end AXIS_DESCR
/end CHARACTERISTIC
/begin CHARACTERISTIC T_air_conversion_cur "" CURVE 0x0000 /* @ECU_Address@T_air_conversion_cur@ */ Lookup1D_WORD 0 VCU_TDN_CM_int16 -32768 32767
 /begin AXIS_DESCR COM_AXIS NO_INPUT_QUANTITY VCU_TDN_CM_int16 29 -32768 32767 AXIS_PTS_REF T_air_conversion_bp /end AXIS_DESCR
/end CHARACTERISTIC
/begin AXIS_PTS Vdc_bus_V_bp "" 0x0000 /* @ECU_Address@Vdc_bus_V_bp@ */ NO_INPUT_QUANTITY Lookup1D_X_WORD 0 VCU_TDN_CM_int16 42 -32768 32767 /end AXIS_PTS
/begin AXIS_PTS T_IGBT_conversion_bp "" 0x0000 /* @ECU_Address@T_IGBT_conversion_bp@ */ NO_INPUT_QUANTITY Lookup1D_X_WORD 0 VCU_TDN_CM_int16 39 -32768 32767 /end AXIS_PTS
/begin AXIS_PTS T_motor_conversion_bp "" 0x0000 /* @ECU_Address@T_motor_conversion_bp@ */ NO_INPUT_QUANTITY Lookup1D_X_WORD 0 VCU_TDN_CM_int16 39 -32768 32767 /end AXIS_PTS
/begin AXIS_PTS T_air_conversion_bp "" 0x0000 /* @ECU_Address@T_air_conversion_bp@ */ NO_INPUT_QUANTITY Lookup1D_X_WORD 0 VCU_TDN_CM_int16 29 -32768 32767 /end AXIS_PTS
/begin MEASUREMENT APPS_M "" FLOAT32_IEEE VCU_TDN_CM_single__ 0 0 -3.4E+38 3.4E+38 ECU_ADDRESS 0x0000 /* @ECU_Address@APPS_M@ */ /end MEASUREMENT
/begin MEASUREMENT FR_BRK_PRESSURE "" FLOAT32_IEEE VCU_TDN_CM_single_bar 0 0 -3.4E+38 3.4E+38 ECU_ADDRESS 0x0000 /* @ECU_Address@FR_BRK_PRESSURE@ */ /end MEASUREMENT
/begin MEASUREMENT RR_BRAKE_PRESSURE "" FLOAT32_IEEE VCU_TDN_CM_single_bar 0 0 -3.4E+38 3.4E+38 ECU_ADDRESS 0x0000 /* @ECU_Address@RR_BRAKE_PRESSURE@ */ /end MEASUREMENT
/begin MEASUREMENT APPS_1 "" UWORD VCU_TDN_CM_uint16 0 0 0 65535 ECU_ADDRESS 0x0000 /* @ECU_Address@APPS_1@ */ /end MEASUREMENT
/begin MEASUREMENT APPS_2 "" UWORD VCU_TDN_CM_uint16 0 0 0 65535 ECU_ADDRESS 0x0000 /* @ECU_Address@APPS_2@ */ /end MEASUREMENT
/begin MEASUREMENT N_lim "" UWORD VCU_TDN_CM_uint16 0 0 0 65535 ECU_ADDRESS 0x0000 /* @ECU_Address@N_lim@ */ /end MEASUREMENT
/begin MEASUREMENT N_100 "" UWORD VCU_TDN_CM_uint16 0 0 0 65535 ECU_ADDRESS 0x0000 /* @ECU_Address@N_100@ */ /end MEASUREMENT
/begin MEASUREMENT Vdc_bus_V "" SWORD VCU_TDN_CM_int16_V 0 0 -32768 32767 ECU_ADDRESS 0x0000 /* @ECU_Address@Vdc_bus_V@ */ /end MEASUREMENT
/begin MEASUREMENT I_act_filt_A "" SWORD VCU_TDN_CM_int16_A 0 0 -32768 32767 ECU_ADDRESS 0x0000 /* @ECU_Address@I_act_filt_A@ */ /end MEASUREMENT
/begin MEASUREMENT N_act_filt_RPM "" SWORD VCU_TDN_CM_int16_RPM 0 0 -32768 32767 ECU_ADDRESS 0x0000 /* @ECU_Address@N_act_filt_RPM@ */ /end MEASUREMENT
/begin MEASUREMENT Speed "" SWORD VCU_TDN_CM_int16_km_h 0 0 -32768 32767 ECU_ADDRESS 0x0000 /* @ECU_Address@Speed@ */ /end MEASUREMENT
/begin MEASUREMENT T_air_deg "" SWORD VCU_TDN_CM_int16__C 0 0 -32768 32767 ECU_ADDRESS 0x0000 /* @ECU_Address@T_air_deg@ */ /end MEASUREMENT
/begin MEASUREMENT T_motor_deg "" SWORD VCU_TDN_CM_int16__C 0 0 -32768 32767 ECU_ADDRESS 0x0000 /* @ECU_Address@T_motor_deg@ */ /end MEASUREMENT
/begin MEASUREMENT T_IGBT_deg "" SWORD VCU_TDN_CM_int16__C 0 0 -32768 32767 ECU_ADDRESS 0x0000 /* @ECU_Address@T_IGBT_deg@ */ /end MEASUREMENT
/begin MEASUREMENT CURRENT_CH_1 "" SWORD VCU_TDN_CM_int16_A 0 0 -32768 32767 ECU_ADDRESS 0x0000 /* @ECU_Address@CURRENT_CH_1@ */ /end MEASUREMENT
/begin MEASUREMENT CURRENT_CH_2 "" SWORD VCU_TDN_CM_int16_A 0 0 -32768 32767 ECU_ADDRESS 0x0000 /* @ECU_Address@CURRENT_CH_2@ */ /end MEASUREMENT
/begin MEASUREMENT T_air "" SWORD VCU_TDN_CM_int16 0 0 -32768 32767 ECU_ADDRESS 0x0000 /* @ECU_Address@T_air@ */ /end MEASUREMENT
/begin MEASUREMENT T_motor "" SWORD VCU_TDN_CM_int16 0 0 -32768 32767 ECU_ADDRESS 0x0000 /* @ECU_Address@T_motor@ */ /end MEASUREMENT
/begin MEASUREMENT T_IGBT "" SWORD VCU_TDN_CM_int16 0 0 -32768 32767 ECU_ADDRESS 0x0000 /* @ECU_Address@T_IGBT@ */ /end MEASUREMENT
/begin MEASUREMENT I_cmd "" SWORD VCU_TDN_CM_int16 0 0 -32768 32767 ECU_ADDRESS 0x0000 /* @ECU_Address@I_cmd@ */ /end MEASUREMENT
/begin MEASUREMENT I_act_filt "" SWORD VCU_TDN_CM_int16 0 0 -32768 32767 ECU_ADDRESS 0x0000 /* @ECU_Address@I_act_filt@ */ /end MEASUREMENT
/begin MEASUREMENT Vdc_bus "" SWORD VCU_TDN_CM_int16 0 0 -32768 32767 ECU_ADDRESS 0x0000 /* @ECU_Address@Vdc_bus@ */ /end MEASUREMENT
/begin MEASUREMENT I_200 "" SWORD VCU_TDN_CM_int16 0 0 -32768 32767 ECU_ADDRESS 0x0000 /* @ECU_Address@I_200@ */ /end MEASUREMENT
/begin MEASUREMENT I_device "" SWORD VCU_TDN_CM_int16 0 0 -32768 32767 ECU_ADDRESS 0x0000 /* @ECU_Address@I_device@ */ /end MEASUREMENT
/begin MEASUREMENT I_max_pk "" SWORD VCU_TDN_CM_int16 0 0 -32768 32767 ECU_ADDRESS 0x0000 /* @ECU_Address@I_max_pk@ */ /end MEASUREMENT
/begin MEASUREMENT I_nom_eff "" SWORD VCU_TDN_CM_int16 0 0 -32768 32767 ECU_ADDRESS 0x0000 /* @ECU_Address@I_nom_eff@ */ /end MEASUREMENT
/begin MEASUREMENT I_max_eff "" SWORD VCU_TDN_CM_int16 0 0 -32768 32767 ECU_ADDRESS 0x0000 /* @ECU_Address@I_max_eff@ */ /end MEASUREMENT
/begin MEASUREMENT SpeedRPMmax "" SWORD VCU_TDN_CM_int16 0 0 -32768 32767 ECU_ADDRESS 0x0000 /* @ECU_Address@SpeedRPMmax@ */ /end MEASUREMENT
/begin MEASUREMENT N_act_filt "" SWORD VCU_TDN_CM_int16 0 0 -32768 32767 ECU_ADDRESS 0x0000 /* @ECU_Address@N_act_filt@ */ /end MEASUREMENT
/begin MEASUREMENT N_R_Dec "" SWORD VCU_TDN_CM_int16 0 0 -32768 32767 ECU_ADDRESS 0x0000 /* @ECU_Address@N_R_Dec@ */ /end MEASUREMENT
/begin MEASUREMENT M_R_Dec "" SWORD VCU_TDN_CM_int16 0 0 -32768 32767 ECU_ADDRESS 0x0000 /* @ECU_Address@M_R_Dec@ */ /end MEASUREMENT
/begin MEASUREMENT N_R_Acc "" SWORD VCU_TDN_CM_int16 0 0 -32768 32767 ECU_ADDRESS 0x0000 /* @ECU_Address@N_R_Acc@ */ /end MEASUREMENT
/begin MEASUREMENT M_R_Acc "" SWORD VCU_TDN_CM_int16 0 0 -32768 32767 ECU_ADDRESS 0x0000 /* @ECU_Address@M_R_Acc@ */ /end MEASUREMENT
/begin MEASUREMENT N_lim_neg "" SWORD VCU_TDN_CM_int16 0 0 -32768 32767 ECU_ADDRESS 0x0000 /* @ECU_Address@N_lim_neg@ */ /end MEASUREMENT
/begin MEASUREMENT N_lim_pos "" SWORD VCU_TDN_CM_int16 0 0 -32768 32767 ECU_ADDRESS 0x0000 /* @ECU_Address@N_lim_pos@ */ /end MEASUREMENT
/begin MEASUREMENT PwrM_flgKeyOnDelay "" UBYTE VCU_TDN_CM_boolean 0 0 0 1 ECU_ADDRESS 0x0000 /* @ECU_Address@PwrM_flgKeyOnDelay@ */ /end MEASUREMENT
/begin MEASUREMENT PwrM_flgKeyOnRaw "" UBYTE VCU_TDN_CM_boolean 0 0 0 1 ECU_ADDRESS 0x0000 /* @ECU_Address@PwrM_flgKeyOnRaw@ */ /end MEASUREMENT
/begin MEASUREMENT BRK_PDL_FAULT "" UBYTE VCU_TDN_CM_boolean 0 0 0 1 ECU_ADDRESS 0x0000 /* @ECU_Address@BRK_PDL_FAULT@ */ /end MEASUREMENT
/begin MEASUREMENT BRK_CONTACTOR "" UBYTE VCU_TDN_CM_boolean 0 0 0 1 ECU_ADDRESS 0x0000 /* @ECU_Address@BRK_CONTACTOR@ */ /end MEASUREMENT
/begin MEASUREMENT RDY_DRV_BUTTON "" UBYTE VCU_TDN_CM_boolean 0 0 0 1 ECU_ADDRESS 0x0000 /* @ECU_Address@RDY_DRV_BUTTON@ */ /end MEASUREMENT
/begin MEASUREMENT RDY_DRV "" UBYTE VCU_TDN_CM_boolean 0 0 0 1 ECU_ADDRESS 0x0000 /* @ECU_Address@RDY_DRV@ */ /end MEASUREMENT
/begin MEASUREMENT BATT_FAN_ON "" UBYTE VCU_TDN_CM_boolean 0 0 0 1 ECU_ADDRESS 0x0000 /* @ECU_Address@BATT_FAN_ON@ */ /end MEASUREMENT
/begin MEASUREMENT FAN_ON "" UBYTE VCU_TDN_CM_boolean 0 0 0 1 ECU_ADDRESS 0x0000 /* @ECU_Address@FAN_ON@ */ /end MEASUREMENT
/begin MEASUREMENT PUMP_ON "" UBYTE VCU_TDN_CM_boolean 0 0 0 1 ECU_ADDRESS 0x0000 /* @ECU_Address@PUMP_ON@ */ /end MEASUREMENT
/begin MEASUREMENT APPS_FAULT "" UBYTE VCU_TDN_CM_boolean 0 0 0 1 ECU_ADDRESS 0x0000 /* @ECU_Address@APPS_FAULT@ */ /end MEASUREMENT
/begin MEASUREMENT nvmAPPS_M "VCU_TDN/Code/APPS and torque setpoint/Throttle setpoint for the inverter/Write NVM" FLOAT32_IEEE VCU_TDN_CM_single 0 0 -3.4E+38 3.4E+38 ECU_ADDRESS 0x0000 /* @ECU_Address@nvmAPPS_M@ */ /end MEASUREMENT
/begin MEASUREMENT nvmI_200 "VCU_TDN/Code/Receiving data/Inverter/Data saving/I_200/Write NVM" SWORD VCU_TDN_CM_int16 0 0 -32768 32767 ECU_ADDRESS 0x0000 /* @ECU_Address@nvmI_200@ */ /end MEASUREMENT
/begin MEASUREMENT nvmI_act_filt "VCU_TDN/Code/Receiving data/Inverter/Data saving/I_act_filt/Write NVM" SWORD VCU_TDN_CM_int16 0 0 -32768 32767 ECU_ADDRESS 0x0000 /* @ECU_Address@nvmI_act_filt@ */ /end MEASUREMENT
/begin MEASUREMENT nvmI_cmd "VCU_TDN/Code/Receiving data/Inverter/Data saving/I_cmd/Write NVM" SWORD VCU_TDN_CM_int16 0 0 -32768 32767 ECU_ADDRESS 0x0000 /* @ECU_Address@nvmI_cmd@ */ /end MEASUREMENT
/begin MEASUREMENT nvmI_device "VCU_TDN/Code/Receiving data/Inverter/Data saving/I_device/Write NVM" SWORD VCU_TDN_CM_int16 0 0 -32768 32767 ECU_ADDRESS 0x0000 /* @ECU_Address@nvmI_device@ */ /end MEASUREMENT
/begin MEASUREMENT nvmI_max_eff "VCU_TDN/Code/Receiving data/Inverter/Data saving/I_max_eff/Write NVM" SWORD VCU_TDN_CM_int16 0 0 -32768 32767 ECU_ADDRESS 0x0000 /* @ECU_Address@nvmI_max_eff@ */ /end MEASUREMENT
/begin MEASUREMENT nvmI_max_pk "VCU_TDN/Code/Receiving data/Inverter/Data saving/I_max_pk/Write NVM" SWORD VCU_TDN_CM_int16 0 0 -32768 32767 ECU_ADDRESS 0x0000 /* @ECU_Address@nvmI_max_pk@ */ /end MEASUREMENT
/begin MEASUREMENT nvmI_nom_eff "VCU_TDN/Code/Receiving data/Inverter/Data saving/I_nom_eff/Write NVM" SWORD VCU_TDN_CM_int16 0 0 -32768 32767 ECU_ADDRESS 0x0000 /* @ECU_Address@nvmI_nom_eff@ */ /end MEASUREMENT
/begin MEASUREMENT nvmM_R_Acc "VCU_TDN/Code/Receiving data/Inverter/Data saving/N_R_Acc | M R_Acc/Write NVM1" SWORD VCU_TDN_CM_int16 0 0 -32768 32767 ECU_ADDRESS 0x0000 /* @ECU_Address@nvmM_R_Acc@ */ /end MEASUREMENT
/begin MEASUREMENT nvmM_R_Dec "VCU_TDN/Code/Receiving data/Inverter/Data saving/N_R_Dec | M_R_Dec/Write NVM1" SWORD VCU_TDN_CM_int16 0 0 -32768 32767 ECU_ADDRESS 0x0000 /* @ECU_Address@nvmM_R_Dec@ */ /end MEASUREMENT
/begin MEASUREMENT nvmN_R_Acc "VCU_TDN/Code/Receiving data/Inverter/Data saving/N_R_Acc | M R_Acc/Write NVM" SWORD VCU_TDN_CM_int16 0 0 -32768 32767 ECU_ADDRESS 0x0000 /* @ECU_Address@nvmN_R_Acc@ */ /end MEASUREMENT
/begin MEASUREMENT nvmN_R_Dec "VCU_TDN/Code/Receiving data/Inverter/Data saving/N_R_Dec | M_R_Dec/Write NVM" SWORD VCU_TDN_CM_int16 0 0 -32768 32767 ECU_ADDRESS 0x0000 /* @ECU_Address@nvmN_R_Dec@ */ /end MEASUREMENT
/begin MEASUREMENT nvmN_act_filt "VCU_TDN/Code/Receiving data/Inverter/Data saving/N_act_filt/Write NVM" SWORD VCU_TDN_CM_int16 0 0 -32768 32767 ECU_ADDRESS 0x0000 /* @ECU_Address@nvmN_act_filt@ */ /end MEASUREMENT
/begin MEASUREMENT nvmN_lim_neg "VCU_TDN/Code/Receiving data/Inverter/Data saving/N_Lim_neg/Write NVM" SWORD VCU_TDN_CM_int16 0 0 -32768 32767 ECU_ADDRESS 0x0000 /* @ECU_Address@nvmN_lim_neg@ */ /end MEASUREMENT
/begin MEASUREMENT nvmN_lim_pos "VCU_TDN/Code/Receiving data/Inverter/Data saving/N_Lim_pos/Write NVM" SWORD VCU_TDN_CM_int16 0 0 -32768 32767 ECU_ADDRESS 0x0000 /* @ECU_Address@nvmN_lim_pos@ */ /end MEASUREMENT
/begin MEASUREMENT nvmSpeedRPMmax "VCU_TDN/Code/Receiving data/Inverter/Data saving/SpeedRPMmax/Write NVM" SWORD VCU_TDN_CM_int16 0 0 -32768 32767 ECU_ADDRESS 0x0000 /* @ECU_Address@nvmSpeedRPMmax@ */ /end MEASUREMENT
/begin MEASUREMENT nvmT_IGBT "VCU_TDN/Code/Receiving data/Inverter/Data saving/T_IGBT/Write NVM" SWORD VCU_TDN_CM_int16 0 0 -32768 32767 ECU_ADDRESS 0x0000 /* @ECU_Address@nvmT_IGBT@ */ /end MEASUREMENT
/begin MEASUREMENT nvmT_air "VCU_TDN/Code/Receiving data/Inverter/Data saving/T_air/Write NVM" SWORD VCU_TDN_CM_int16 0 0 -32768 32767 ECU_ADDRESS 0x0000 /* @ECU_Address@nvmT_air@ */ /end MEASUREMENT
/begin MEASUREMENT nvmT_motor "VCU_TDN/Code/Receiving data/Inverter/Data saving/T_motor/Write NVM" SWORD VCU_TDN_CM_int16 0 0 -32768 32767 ECU_ADDRESS 0x0000 /* @ECU_Address@nvmT_motor@ */ /end MEASUREMENT
/begin MEASUREMENT nvmVdc_bus "VCU_TDN/Code/Receiving data/Inverter/Data saving/Vdc_bus/Write NVM" SWORD VCU_TDN_CM_int16 0 0 -32768 32767 ECU_ADDRESS 0x0000 /* @ECU_Address@nvmVdc_bus@ */ /end MEASUREMENT
/begin MEASUREMENT nvmI_act_filt_A "VCU_TDN/Code/Data processing/Electrical/Write NVM" SWORD VCU_TDN_CM_int16 0 0 -32768 32767 ECU_ADDRESS 0x0000 /* @ECU_Address@nvmI_act_filt_A@ */ /end MEASUREMENT
/begin MEASUREMENT nvmN_act_filt_RPM "VCU_TDN/Code/Data processing/Speed/Write NVM1" SWORD VCU_TDN_CM_int16 0 0 -32768 32767 ECU_ADDRESS 0x0000 /* @ECU_Address@nvmN_act_filt_RPM@ */ /end MEASUREMENT
/begin MEASUREMENT nvmSpeed "VCU_TDN/Code/Data processing/Speed/Write NVM" SWORD VCU_TDN_CM_int16 0 0 -32768 32767 ECU_ADDRESS 0x0000 /* @ECU_Address@nvmSpeed@ */ /end MEASUREMENT
/begin MEASUREMENT nvmT_IGBT_deg "VCU_TDN/Code/Data processing/Temperature/Write NVM" SWORD VCU_TDN_CM_int16 0 0 -32768 32767 ECU_ADDRESS 0x0000 /* @ECU_Address@nvmT_IGBT_deg@ */ /end MEASUREMENT
/begin MEASUREMENT nvmT_air_deg "VCU_TDN/Code/Data processing/Temperature/Write NVM2" SWORD VCU_TDN_CM_int16 0 0 -32768 32767 ECU_ADDRESS 0x0000 /* @ECU_Address@nvmT_air_deg@ */ /end MEASUREMENT
/begin MEASUREMENT nvmT_motor_deg "VCU_TDN/Code/Data processing/Temperature/Write NVM1" SWORD VCU_TDN_CM_int16 0 0 -32768 32767 ECU_ADDRESS 0x0000 /* @ECU_Address@nvmT_motor_deg@ */ /end MEASUREMENT
/begin MEASUREMENT nvmVdc_bus_V "VCU_TDN/Code/Data processing/Electrical/Write NVM2" SWORD VCU_TDN_CM_int16 0 0 -32768 32767 ECU_ADDRESS 0x0000 /* @ECU_Address@nvmVdc_bus_V@ */ /end MEASUREMENT
/begin MEASUREMENT nvmAPPS_1 "VCU_TDN/Code/APPS and torque setpoint/Write NVM" UWORD VCU_TDN_CM_uint16 0 0 0 65535 ECU_ADDRESS 0x0000 /* @ECU_Address@nvmAPPS_1@ */ /end MEASUREMENT
/begin MEASUREMENT nvmAPPS_2 "VCU_TDN/Code/APPS and torque setpoint/Write NVM1" UWORD VCU_TDN_CM_uint16 0 0 0 65535 ECU_ADDRESS 0x0000 /* @ECU_Address@nvmAPPS_2@ */ /end MEASUREMENT
/begin MEASUREMENT nvmN_100 "VCU_TDN/Code/Receiving data/Inverter/Data saving/N_100/Write NVM" UWORD VCU_TDN_CM_uint16 0 0 0 65535 ECU_ADDRESS 0x0000 /* @ECU_Address@nvmN_100@ */ /end MEASUREMENT
/begin MEASUREMENT nvmN_lim "VCU_TDN/Code/Receiving data/Inverter/Data saving/N_Lim/Write NVM" UWORD VCU_TDN_CM_uint16 0 0 0 65535 ECU_ADDRESS 0x0000 /* @ECU_Address@nvmN_lim@ */ /end MEASUREMENT
/begin MEASUREMENT nvmAPPS_FAULT "VCU_TDN/Code/APPS and torque setpoint/APPS Fault detection/Write NVM" UBYTE VCU_TDN_CM_boolean 0 0 0 1 ECU_ADDRESS 0x0000 /* @ECU_Address@nvmAPPS_FAULT@ */ /end MEASUREMENT
/begin MEASUREMENT nvmBRK_CONTACTOR "VCU_TDN/Code/Ready to drive/Write NVM" UBYTE VCU_TDN_CM_boolean 0 0 0 1 ECU_ADDRESS 0x0000 /* @ECU_Address@nvmBRK_CONTACTOR@ */ /end MEASUREMENT
/begin MEASUREMENT nvmBRK_PDL_FAULT "VCU_TDN/Code/Brake pedal plausibility check/Write NVM" UBYTE VCU_TDN_CM_boolean 0 0 0 1 ECU_ADDRESS 0x0000 /* @ECU_Address@nvmBRK_PDL_FAULT@ */ /end MEASUREMENT
/begin MEASUREMENT nvmRDY_DRV "VCU_TDN/Code/Ready to drive/Write NVM2" UBYTE VCU_TDN_CM_boolean 0 0 0 1 ECU_ADDRESS 0x0000 /* @ECU_Address@nvmRDY_DRV@ */ /end MEASUREMENT
/begin MEASUREMENT nvmRDY_DRV_BUTTON "VCU_TDN/Code/Ready to drive/Write NVM1" UBYTE VCU_TDN_CM_boolean 0 0 0 1 ECU_ADDRESS 0x0000 /* @ECU_Address@nvmRDY_DRV_BUTTON@ */ /end MEASUREMENT
/begin MEASUREMENT nvmBATT_FAN_ON "VCU_TDN/Code/Pump and fans/Write NVM2" UBYTE VCU_TDN_CM_boolean 0 0 0 1 ECU_ADDRESS 0x0000 /* @ECU_Address@nvmBATT_FAN_ON@ */ /end MEASUREMENT
/begin MEASUREMENT nvmFAN_ON "VCU_TDN/Code/Pump and fans/Write NVM1" UBYTE VCU_TDN_CM_boolean 0 0 0 1 ECU_ADDRESS 0x0000 /* @ECU_Address@nvmFAN_ON@ */ /end MEASUREMENT
/begin MEASUREMENT nvmPUMP_ON "VCU_TDN/Code/Pump and fans/Write NVM" UBYTE VCU_TDN_CM_boolean 0 0 0 1 ECU_ADDRESS 0x0000 /* @ECU_Address@nvmPUMP_ON@ */ /end MEASUREMENT
/begin COMPU_METHOD VCU_TDN_CM_int16 "Q = V" RAT_FUNC "%5.0" "" COEFFS 0 1 0 0 0 1 /end COMPU_METHOD
/begin COMPU_METHOD VCU_TDN_CM_single__ "Q = V" RAT_FUNC "%8.6" "%" COEFFS 0 1 0 0 0 1 /end COMPU_METHOD
/begin COMPU_METHOD VCU_TDN_CM_single_bar "Q = V" RAT_FUNC "%8.6" "bar" COEFFS 0 1 0 0 0 1 /end COMPU_METHOD
/begin COMPU_METHOD VCU_TDN_CM_uint16 "Q = V" RAT_FUNC "%5.0" "" COEFFS 0 1 0 0 0 1 /end COMPU_METHOD
/begin COMPU_METHOD VCU_TDN_CM_int16_V "Q = V" RAT_FUNC "%5.0" "V" COEFFS 0 1 0 0 0 1 /end COMPU_METHOD
/begin COMPU_METHOD VCU_TDN_CM_int16_A "Q = V" RAT_FUNC "%5.0" "A" COEFFS 0 1 0 0 0 1 /end COMPU_METHOD
/begin COMPU_METHOD VCU_TDN_CM_int16_RPM "Q = V" RAT_FUNC "%5.0" "RPM" COEFFS 0 1 0 0 0 1 /end COMPU_METHOD
/begin COMPU_METHOD VCU_TDN_CM_int16_km_h "Q = V" RAT_FUNC "%5.0" "km/h" COEFFS 0 1 0 0 0 1 /end COMPU_METHOD
/begin COMPU_METHOD VCU_TDN_CM_int16__C "Q = V" RAT_FUNC "%5.0" "°C" COEFFS 0 1 0 0 0 1 /end COMPU_METHOD
/begin COMPU_METHOD VCU_TDN_CM_boolean "Q = V" RAT_FUNC "%1.0" "" COEFFS 0 1 0 0 0 1 /end COMPU_METHOD
/begin COMPU_METHOD VCU_TDN_CM_single "Q = V" RAT_FUNC "%8.6" "" COEFFS 0 1 0 0 0 1 /end COMPU_METHOD
/begin GROUP VCU_TDN "VCU_TDN" /* Root */ ROOT /begin SUB_GROUP Root_Code Root_Power_Management_Example /end SUB_GROUP
 /begin REF_MEASUREMENT nvmAPPS_1 nvmAPPS_2 nvmAPPS_FAULT nvmAPPS_M nvmBATT_FAN_ON nvmBRK_CONTACTOR nvmBRK_PDL_FAULT nvmFAN_ON nvmI_200 nvmI_act_filt nvmI_act_filt_A nvmI_cmd nvmI_device nvmI_max_eff nvmI_max_pk nvmI_nom_eff nvmM_R_Acc nvmM_R_Dec nvmN_100 nvmN_R_Acc nvmN_R_Dec nvmN_act_filt nvmN_act_filt_RPM nvmN_lim nvmN_lim_neg nvmN_lim_pos nvmPUMP_ON nvmRDY_DRV nvmRDY_DRV_BUTTON nvmSpeed nvmSpeedRPMmax nvmT_IGBT nvmT_IGBT_deg nvmT_air nvmT_air_deg nvmT_motor nvmT_motor_deg nvmVdc_bus nvmVdc_bus_V /end REF_MEASUREMENT
/end GROUP
/begin GROUP Root_Code "VCU_TDN/Code"
 /begin SUB_GROUP S1_APPS_and_torque_setpoint S1_Brake_pedal_plausibility_check S1_Data_processing S1_Pump_and_fans S1_Ready_to_drive S1_Receiving_data /end SUB_GROUP
/end GROUP
/begin GROUP Root_Power_Management_Example "VCU_TDN/Power Management Example" /begin SUB_GROUP S3_Power_Off_Management /end SUB_GROUP /end GROUP
/begin GROUP S1_APPS_and_torque_setpoint "VCU_TDN/Code/APPS and torque setpoint"
 /begin SUB_GROUP S4_APPS_Fault_detection S4_Throttle_setpoint_for_the_inverter /end SUB_GROUP
 /begin REF_MEASUREMENT APPS_1 APPS_2 /end REF_MEASUREMENT
/end GROUP
/begin GROUP S1_Brake_pedal_plausibility_check "VCU_TDN/Code/Brake pedal plausibility check" /begin REF_MEASUREMENT BRK_PDL_FAULT /end REF_MEASUREMENT /end GROUP
/begin GROUP S1_Data_processing "VCU_TDN/Code/Data processing" /begin SUB_GROUP S7_Electrical S7_Speed S7_Temperature /end SUB_GROUP /end GROUP
/begin GROUP S1_Pump_and_fans "VCU_TDN/Code/Pump and fans" /begin REF_MEASUREMENT BATT_FAN_ON FAN_ON PUMP_ON /end REF_MEASUREMENT /end GROUP
/begin GROUP S1_Ready_to_drive "VCU_TDN/Code/Ready to drive" /begin SUB_GROUP S10_SR_Flip_Flop /end SUB_GROUP /begin REF_MEASUREMENT BRK_CONTACTOR RDY_DRV_BUTTON /end REF_MEASUREMENT /end GROUP
/begin GROUP S1_Receiving_data "VCU_TDN/Code/Receiving data" /begin SUB_GROUP S11_Inverter S11_Sensors /end SUB_GROUP /end GROUP
/begin GROUP S3_Power_Off_Management "VCU_TDN/Power Management Example/Power Off Management" /begin SUB_GROUP S116_Get_flgKeyOn S116_TOfD_xxxx1 /end SUB_GROUP /end GROUP
/begin GROUP S4_APPS_Fault_detection "VCU_TDN/Code/APPS and torque setpoint/APPS Fault detection" /begin REF_MEASUREMENT APPS_FAULT /end REF_MEASUREMENT /end GROUP
/begin GROUP S4_Throttle_setpoint_for_the_inverter "VCU_TDN/Code/APPS and torque setpoint/Throttle setpoint for the inverter" /begin REF_MEASUREMENT APPS_M /end REF_MEASUREMENT /end GROUP
/begin GROUP S7_Electrical "VCU_TDN/Code/Data processing/Electrical" /begin REF_CHARACTERISTIC Vdc_bus_V_cur /end REF_CHARACTERISTIC /begin REF_MEASUREMENT I_act_filt_A Vdc_bus_V /end REF_MEASUREMENT /end GROUP
/begin GROUP S7_Speed "VCU_TDN/Code/Data processing/Speed" /begin REF_MEASUREMENT N_act_filt_RPM Speed /end REF_MEASUREMENT /end GROUP
/begin GROUP S7_Temperature "VCU_TDN/Code/Data processing/Temperature"
 /begin REF_CHARACTERISTIC T_IGBT_conversion_cur T_air_conversion_cur T_motor_conversion_cur /end REF_CHARACTERISTIC
 /begin REF_MEASUREMENT T_IGBT_deg T_air_deg T_motor_deg /end REF_MEASUREMENT
/end GROUP
/begin GROUP S10_SR_Flip_Flop "VCU_TDN/Code/Ready to drive/SR Flip Flop" /begin REF_MEASUREMENT RDY_DRV /end REF_MEASUREMENT /end GROUP
/begin GROUP S11_Inverter "VCU_TDN/Code/Receiving data/Inverter" /begin SUB_GROUP S64_Data_saving /end SUB_GROUP /end GROUP
/begin GROUP S11_Sensors "VCU_TDN/Code/Receiving data/Sensors"
 /begin REF_MEASUREMENT CURRENT_CH_1 CURRENT_CH_2 FR_BRK_PRESSURE RR_BRAKE_PRESSURE /end REF_MEASUREMENT
/end GROUP
/begin GROUP S116_Get_flgKeyOn "VCU_TDN/Power Management Example/Power Off Management/Get flgKeyOn" /begin REF_MEASUREMENT PwrM_flgKeyOnRaw /end REF_MEASUREMENT /end GROUP
/begin GROUP S116_TOfD_xxxx1 "VCU_TDN/Power Management Example/Power Off Management/TOfD_xxxx1" /begin REF_MEASUREMENT PwrM_flgKeyOnDelay /end REF_MEASUREMENT /end GROUP
/begin GROUP S64_Data_saving "VCU_TDN/Code/Receiving data/Inverter/Data saving"
 /begin SUB_GROUP S66_I_200 S66_I_act_filt S66_I_cmd S66_I_device S66_I_max_eff S66_I_max_pk S66_I_nom_eff S66_N_100 S66_N_Lim S66_N_Lim_neg S66_N_Lim_pos S66_N_R_Acc___M_R_Acc S66_N_R_Dec___M_R_Dec S66_N_act_filt S66_SpeedRPMmax S66_T_IGBT S66_T_air S66_T_motor S66_Vdc_bus /end SUB_GROUP
/end GROUP
/begin GROUP S66_I_200 "VCU_TDN/Code/Receiving data/Inverter/Data saving/I_200" /begin REF_MEASUREMENT I_200 /end REF_MEASUREMENT /end GROUP
/begin GROUP S66_I_act_filt "VCU_TDN/Code/Receiving data/Inverter/Data saving/I_act_filt" /begin REF_MEASUREMENT I_act_filt /end REF_MEASUREMENT /end GROUP
/begin GROUP S66_I_cmd "VCU_TDN/Code/Receiving data/Inverter/Data saving/I_cmd" /begin REF_MEASUREMENT I_cmd /end REF_MEASUREMENT /end GROUP
/begin GROUP S66_I_device "VCU_TDN/Code/Receiving data/Inverter/Data saving/I_device" /begin REF_MEASUREMENT I_device /end REF_MEASUREMENT /end GROUP
/begin GROUP S66_I_max_eff "VCU_TDN/Code/Receiving data/Inverter/Data saving/I_max_eff" /begin REF_MEASUREMENT I_max_eff /end REF_MEASUREMENT /end GROUP
/begin GROUP S66_I_max_pk "VCU_TDN/Code/Receiving data/Inverter/Data saving/I_max_pk" /begin REF_MEASUREMENT I_max_pk /end REF_MEASUREMENT /end GROUP
/begin GROUP S66_I_nom_eff "VCU_TDN/Code/Receiving data/Inverter/Data saving/I_nom_eff" /begin REF_MEASUREMENT I_nom_eff /end REF_MEASUREMENT /end GROUP
/begin GROUP S66_N_100 "VCU_TDN/Code/Receiving data/Inverter/Data saving/N_100" /begin REF_MEASUREMENT N_100 /end REF_MEASUREMENT /end GROUP
/begin GROUP S66_N_Lim "VCU_TDN/Code/Receiving data/Inverter/Data saving/N_Lim" /begin REF_MEASUREMENT N_lim /end REF_MEASUREMENT /end GROUP
/begin GROUP S66_N_Lim_neg "VCU_TDN/Code/Receiving data/Inverter/Data saving/N_Lim_neg" /begin REF_MEASUREMENT N_lim_neg /end REF_MEASUREMENT /end GROUP
/begin GROUP S66_N_Lim_pos "VCU_TDN/Code/Receiving data/Inverter/Data saving/N_Lim_pos" /begin REF_MEASUREMENT N_lim_pos /end REF_MEASUREMENT /end GROUP
/begin GROUP S66_N_R_Acc___M_R_Acc "VCU_TDN/Code/Receiving data/Inverter/Data saving/N_R_Acc | M R_Acc" /begin REF_MEASUREMENT M_R_Acc N_R_Acc /end REF_MEASUREMENT /end GROUP
/begin GROUP S66_N_R_Dec___M_R_Dec "VCU_TDN/Code/Receiving data/Inverter/Data saving/N_R_Dec | M_R_Dec" /begin REF_MEASUREMENT M_R_Dec N_R_Dec /end REF_MEASUREMENT /end GROUP
/begin GROUP S66_N_act_filt "VCU_TDN/Code/Receiving data/Inverter/Data saving/N_act_filt" /begin REF_MEASUREMENT N_act_filt /end REF_MEASUREMENT /end GROUP
/begin GROUP S66_SpeedRPMmax "VCU_TDN/Code/Receiving data/Inverter/Data saving/SpeedRPMmax" /begin REF_MEASUREMENT SpeedRPMmax /end REF_MEASUREMENT /end GROUP
/begin GROUP S66_T_IGBT "VCU_TDN/Code/Receiving data/Inverter/Data saving/T_IGBT" /begin REF_MEASUREMENT T_IGBT /end REF_MEASUREMENT /end GROUP
/begin GROUP S66_T_air "VCU_TDN/Code/Receiving data/Inverter/Data saving/T_air" /begin REF_MEASUREMENT T_air /end REF_MEASUREMENT /end GROUP
/begin GROUP S66_T_motor "VCU_TDN/Code/Receiving data/Inverter/Data saving/T_motor" /begin REF_MEASUREMENT T_motor /end REF_MEASUREMENT /end GROUP
/begin GROUP S66_Vdc_bus "VCU_TDN/Code/Receiving data/Inverter/Data saving/Vdc_bus" /begin REF_MEASUREMENT Vdc_bus /end REF_MEASUREMENT /end GROUP
/end MODULE
/end PROJECT
/* (add any file trailer comments here) */
/* EOF VCU_TDN.a2l */
