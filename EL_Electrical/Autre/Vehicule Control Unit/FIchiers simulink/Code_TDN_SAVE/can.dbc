VERSION ""

NS_ :

BS_:

BU_: VCU BMS TEMP_HV INV

BO_ 385 INV_VCU: 6 INV
 SG_ INV_VCU_RegID : 0|8@1+ (1,0) [0|0] "" Vector__XXX
 SG_ INV_VCU_Data : 8|32@1+ (1,0) [0|0] "" Vector__XXX

BO_ 513 VCU_INV_16: 3 VCU
 SG_ VCU_INV_16_RegID : 0|8@1+ (1,0) [0|0] "" Vector__XXX
 SG_ VCU_INV_16_Data : 8|16@1+ (1,0) [0|0] "" Vector__XXX

BO_ 513 VCU_INV_32: 5 VCU
 SG_ VCU_INV_32_RegID : 0|8@1+ (1,0) [0|0] "" Vector__XXX
 SG_ VCU_INV_32_Data : 8|32@1+ (1,0) [0|0] "" Vector__XXX
